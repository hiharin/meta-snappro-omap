## conf/layer.conf
```bitbake
# We have a conf and classes directory, add to BBPATH
BBPATH .= ":${LAYERDIR}"

# We have recipes-* directories, add to BBFILES
BBFILES += "${LAYERDIR}/recipes-*/*/*.bb \
	${LAYERDIR}/recipes-*/*/*.bbappend"

BBFILE_COLLECTIONS += "snappro-omap"
BBFILE_PATTERN_snappro-omap = "^${LAYERDIR}/"
BBFILE_PRIORITY_snappro-omap = "6"
```
